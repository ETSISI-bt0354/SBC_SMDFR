## SMDFR/main/Kconfig.projbuild
```kconfig
orsource "$IDF_PATH/examples/common_components/env_caps/$IDF_TARGET/Kconfig.env_caps"

menu "I2C Configuration"
    config I2C_SCL
        int "SCL GPIO Num"
        range ENV_GPIO_RANGE_MIN ENV_GPIO_IN_RANGE_MAX
        default 32
        help
            GPIO number for I2C Master clock line.

    config I2C_SDA
        int "SDA GPIO Num"
        range ENV_GPIO_RANGE_MIN ENV_GPIO_IN_RANGE_MAX
        default 33
        help
            GPIO number for I2C Master data line.

    config I2C_TIMEOUT
        int "I2C Timeout in Miliseconds"
        default 1000
        help
            Timeout of i2c communications in miliseconds.
endmenu

menu "BME280 Configuration"
    config I2C_BME280_FREQ
        int "I2C BME280 Frequency in Hz"
        default 400000
        help
            Frequency of the i2c comms with bme280.
endmenu

menu "SGP30 Configuration"
    config I2C_SGP30_FREQ
        int "I2C BME280 Frequency in Hz"
        default 100000
        help
            Frequency of the i2c comms with bme280.
endmenu

menu "Fona Configuration"
    config UART_PORT_NUM
        int "UART port number"
        range 0 2 if IDF_TARGET_ESP32 || IDF_TARGET_ESP32S3
        range 0 1
        default 1
        help
            UART communication port number for the example.
            See UART documentation for available port numbers.

    config UART_BAUD_RATE
        int "UART communication speed"
        range 1200 115200
        default 9600
        help
            UART communication speed for Modbus example.

    config UART_RXD
        int "UART RXD pin number"
        range ENV_GPIO_RANGE_MIN ENV_GPIO_IN_RANGE_MAX
        default 14
        help
            GPIO number for UART RX pin. See UART documentation for more information
            about available pin numbers for UART.

    config UART_TXD
        int "UART TXD pin number"
        range ENV_GPIO_RANGE_MIN ENV_GPIO_OUT_RANGE_MAX
        default 12
        help
            GPIO number for UART TX pin. See UART documentation for more information
            about available pin numbers for UART.

    config UART_RX_TIMEOUT
        int "UART Receive Timeout in Miliseconds"
        default 1000
        help
            Timeout of UART receive communications in miliseconds.

    config APN
        string "APN"
        default "airtelwap.es"
endmenu

menu "Server Configuration"
    config SERVER_IP
        string "Server IP"
        default "31.220.77.64"
        help
            IP of the server to send data.

    config SERVER_PORT
        string "Server Port"
        default "8239"
        help
            Port of the server to send data.
endmenu

menu "ESP Now Configuration"
    config ESPNOW_CHANNEL
        int "Channel"
        range 0 14
        default 1
        help
            The channel on which sending and receiving ESPNOW data.

    config MASTER_MAC
        hex "Master MAC"
        range 0 0xffffffffffff
        default 0x2462abf2142c
        help
            MAC of master receiving the data.
endmenu

choice ESPNOW_DEVICE_Role
    prompt "Device role"
    default MASTER_ROLE
    help
        Can the device send data has an LTE connection?

    config MASTER_ROLE
        bool "Master"
    config SLAVE_ROLE
        bool "Slave"
endchoice

menu "Sleep Configuration"
    config WAKE_PERIOD
        int "Wake Period"
        default 300
        help
            Time (seconds) between device wake up.

    config RECEIVE_INTERVAL
        int "Receive Interval"
        default 60
        help
            Time (seconds) the device is receiving message.
endmenu
```
